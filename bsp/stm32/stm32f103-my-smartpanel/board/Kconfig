## bsp/stm32/stm32f103-my-smartpanel/board/Kconfig
```kconfig
menu "Hardware Drivers Config"

config SOC_STM32F103CB
    bool
    select SOC_SERIES_STM32F1
    select RT_USING_COMPONENTS_INIT
    select RT_USING_USER_MAIN
    default y

menu "Onboard Peripheral Drivers"
	config BSP_USING_RS232
		bool "Enable RS232 (uart1)"
		select BSP_USING_UART
		select BSP_USING_UART1
		default y
	
	config BSP_USING_HMI
		bool "Enable Human Machine Interface (uart2)"
		select BSP_USING_UART
		select BSP_USING_UART2
		default n
	
	config BSP_USING_ASR
		bool "Enable Automatic Speech Recognition (uart3)"
		default n
		select BSP_USING_UART
		select BSP_USING_UART3
        select RT_USING_PIN
		if BSP_USING_ASR
			config ASR_S1_PIN
				int "S1 PIN Number"
				default 4
			config ASR_S2_PIN
				int "S2 PIN Number"
				default 5
			config ASR_S3_PIN
				int "S3 PIN Number"
				default 6
			config ASR_S4_PIN
				int "S4 PIN Number"
				default 7
		endif
	
	config BSP_USING_GRS
		bool "Enable Gesture Recognition Sensor (PAJ7620 Driver i2c1)"
		default n
        select RT_USING_PIN
		select BSP_USING_I2C1
		select PKG_USING_PAJ7620
		if BSP_USING_GRS
			config PAJ_INT_PIN
				int "INT PIN Number"
				default 11
		endif
endmenu

menu "On-chip Peripheral Drivers"

    config BSP_USING_GPIO
        bool "Enable GPIO"
        select RT_USING_PIN
        default y

    menuconfig BSP_USING_UART
        bool "Enable UART"
        default y
        select RT_USING_SERIAL
        if BSP_USING_UART
            config BSP_USING_UART1
                bool "Enable UART1"
                default y

            config BSP_UART1_RX_USING_DMA
                bool "Enable UART1 RX DMA"
                depends on BSP_USING_UART1 && RT_SERIAL_USING_DMA
                default n
				
			config BSP_USING_UART2
                bool "Enable UART2"
                default n

            config BSP_UART2_RX_USING_DMA
                bool "Enable UART2 RX DMA"
                depends on BSP_USING_UART2 && RT_SERIAL_USING_DMA
                default n
				
            config BSP_USING_UART3
                bool "Enable UART3"
                default n

            config BSP_UART3_RX_USING_DMA
                bool "Enable UART3 RX DMA"
                depends on BSP_USING_UART3 && RT_SERIAL_USING_DMA
                default n
        endif
		
	menuconfig BSP_USING_I2C1
		bool "Enable I2C1 BUS"
        default n
        select RT_USING_I2C
        select RT_USING_I2C_BITOPS
        select RT_USING_PIN
        if BSP_USING_I2C1
            config BSP_I2C1_SCL_PIN
                int "i2c1 scl pin number"
                range 0 175
                default 22
            config BSP_I2C1_SDA_PIN
                int "I2C1 sda pin number"
                range 0 175
                default 23
        endif
		
	menuconfig BSP_USING_ONCHIP_RTC
        bool "Enable RTC"
        select RT_USING_RTC
        select RT_USING_LIBC
        default n
        if BSP_USING_ONCHIP_RTC
            choice
                prompt "Select clock source"
                default BSP_RTC_USING_LSE

                config BSP_RTC_USING_LSE
                    bool "RTC USING LSE"

                config BSP_RTC_USING_LSI
                    bool "RTC USING LSI"
            endchoice
        endif

    menuconfig BSP_USING_CAN
        bool "Enable CAN"
        default n
        select RT_USING_CAN
		if BSP_USING_CAN
			config BSP_USING_CAN1
                bool "Enable CAN1"
                default n
				
			config RT_CAN_USING_HDR
				bool "Enable Hardware filter"
                default n
        endif
		
    config BSP_USING_ON_CHIP_FLASH
        bool "Enable on-chip FLASH"
        default n
		
    config BSP_USING_WDT
        bool "Enable Watchdog Timer"
        select RT_USING_WDT
        default n
		
    source "../libraries/HAL_Drivers/Kconfig"
       
endmenu

menu "Board extended module Drivers"

endmenu

endmenu
```

## bsp/stm32/stm32f407-my-motorcontroller/board/Kconfig
```kconfig
menu "Hardware Drivers Config"

config SOC_STM32F407VG
    bool
    select SOC_SERIES_STM32F4
    select RT_USING_COMPONENTS_INIT
    select RT_USING_USER_MAIN
    default y

menu "Onboard Peripheral Drivers"
    config BSP_USING_RS232_TO_USART
        bool "Enable RS232 TO USART (uart3)"
        select BSP_USING_UART
        select BSP_USING_UART3
        default y
	
	
	config BSP_USING_BT
        bool "Enable Bluetooth (uart4)"
        select BSP_USING_UART
        select BSP_USING_UART4
        default n
	
	config BSP_USING_JDY
        bool "Enable JDY (uart1)"
        select BSP_USING_UART
        select BSP_USING_UART1
        default n
	
	
	menuconfig BSP_USING_BT
	
endmenu

menu "On-chip Peripheral Drivers"

    config BSP_USING_GPIO
        bool "Enable GPIO"
        select RT_USING_PIN
        default y

    menuconfig BSP_USING_UART
        bool "Enable UART"
        default n
        select RT_USING_SERIAL
        if BSP_USING_UART
			config BSP_USING_UART1
                bool "Enable UART1"
                default n

            config BSP_UART1_RX_USING_DMA
                bool "Enable UART1 RX DMA"
                depends on BSP_USING_UART1 && RT_SERIAL_USING_DMA
                default n
				
			config BSP_USING_UART3
                bool "Enable UART3"
                default n

            config BSP_UART3_RX_USING_DMA
                bool "Enable UART3 RX DMA"
                depends on BSP_USING_UART3 && RT_SERIAL_USING_DMA
                default n
				
			config BSP_USING_UART4
                bool "Enable UART4"
                default n

            config BSP_UART4_RX_USING_DMA
                bool "Enable UART4 RX DMA"
                depends on BSP_USING_UART4 && RT_SERIAL_USING_DMA
                default n
				
			config BSP_USING_UART6
                bool "Enable UART6"
                default n

            config BSP_UART6_RX_USING_DMA
                bool "Enable UART6 RX DMA"
                depends on BSP_USING_UART6 && RT_SERIAL_USING_DMA
                default n
        endif
	
	menuconfig BSP_USING_TIM
        bool "Enable timer"
        default n
        select RT_USING_HWTIMER
		if BSP_USING_TIM
			config BSP_USING_TIM14
                bool "Enable TIM14"
                default n
		endif
	 
	 menuconfig BSP_USING_PWM
        bool "Enable pwm"
        default n
        select RT_USING_PWM
        if BSP_USING_PWM
			config BSP_USING_PWM1
				bool "Enable timer1 output pwm"
				default n
				if BSP_USING_PWM1
					config BSP_USING_PWM1_CH1
						bool "Enable PWM1 channel1"
						default n
						
					config BSP_USING_PWM1_CH3
						bool "Enable PWM1 channel3"
						default n
				endif
        endif
    
    menuconfig BSP_USING_INPUT_CAPTURE
        bool "Enable Input Capture"
        default n
        select RT_USING_INPUT_CAPTURE
        if BSP_USING_INPUT_CAPTURE
			config BSP_USING_INPUT_CAPTURE2
				bool "Enable Input Capture2"
				default n
				if BSP_USING_INPUT_CAPTURE2 
					choice
						prompt "Select Input Capture Channel"
						default BSP_USING_INPUT_CAPTURE2_CH1

						config BSP_USING_INPUT_CAPTURE2_CH1
							bool "Input Capture2 Using Channel 1"

						config BSP_USING_INPUT_CAPTURE2_CH2
							bool "Input Capture2 Using Channel 2"

						config BSP_USING_INPUT_CAPTURE2_CH3
							bool "Input Capture2 Using Channel 3"

						config BSP_USING_INPUT_CAPTURE2_CH4
							bool "Input Capture2 Using Channel 4"
					endchoice
				endif

			config BSP_USING_INPUT_CAPTURE3
				bool "Enable Input Capture3"
				default n
				if BSP_USING_INPUT_CAPTURE3
					choice
						prompt "Select Input Capture Channel"
						default BSP_USING_INPUT_CAPTURE3_CH1

						config BSP_USING_INPUT_CAPTURE3_CH1
							bool "Input Capture3 Using Channel 1"

						config BSP_USING_INPUT_CAPTURE3_CH2
							bool "Input Capture3 Using Channel 2"

						config BSP_USING_INPUT_CAPTURE3_CH3
							bool "Input Capture3 Using Channel 3"

						config BSP_USING_INPUT_CAPTURE3_CH4
							bool "Input Capture3 Using Channel 4"
					endchoice
				endif

			config BSP_USING_INPUT_CAPTURE4
				bool "Enable Input Capture4"
				default n
				if BSP_USING_INPUT_CAPTURE4
					choice
						prompt "Select Input Capture Channel"
						default BSP_USING_INPUT_CAPTURE4_CH1

						config BSP_USING_INPUT_CAPTURE4_CH1
							bool "Input Capture4 Using Channel 1"

						config BSP_USING_INPUT_CAPTURE4_CH2
							bool "Input Capture4 Using Channel 2"

						config BSP_USING_INPUT_CAPTURE4_CH3
							bool "Input Capture4Using Channel 3"

						config BSP_USING_INPUT_CAPTURE4_CH4
							bool "Input Capture4 Using Channel 4"
					endchoice
				endif

			config BSP_USING_INPUT_CAPTURE5
				bool "Enable Input Capture5"
				default n
				if BSP_USING_INPUT_CAPTURE5
					choice
						prompt "Select Input Capture Channel"
						default BSP_USING_INPUT_CAPTURE5_CH1

						config BSP_USING_INPUT_CAPTURE5_CH1
							bool "Input Capture5 Using Channel 1"

						config BSP_USING_INPUT_CAPTURE5_CH2
							bool "Input Capture5 Using Channel 2"

						config BSP_USING_INPUT_CAPTURE5_CH3
							bool "Input Capture5 Using Channel 3"

						config BSP_USING_INPUT_CAPTURE5_CH4
							bool "Input Capture5 Using Channel 4"
					endchoice
				endif
                
        endif
		
    menuconfig BSP_USING_ONCHIP_RTC
        bool "Enable RTC"
        select RT_USING_RTC
        select RT_USING_LIBC
        default n
        if BSP_USING_ONCHIP_RTC
            choice
                prompt "Select clock source"
                default BSP_RTC_USING_LSE

                config BSP_RTC_USING_LSE
                    bool "RTC USING LSE"

                config BSP_RTC_USING_LSI
                    bool "RTC USING LSI"
            endchoice
        endif

    menuconfig BSP_USING_CAN
        bool "Enable CAN"
        default n
        select RT_USING_CAN
		if BSP_USING_CAN
			config BSP_USING_CAN1
                bool "Enable CAN1"
                default n
			
			config BSP_USING_CAN2
                bool "Enable CAN2"
                default n
				
			config RT_CAN_USING_HDR
				bool "Enable Hardware filter"
                default n
        endif
		
    config BSP_USING_ON_CHIP_FLASH
        bool "Enable on-chip FLASH"
        default n
		
    config BSP_USING_WDT
        bool "Enable Watchdog Timer"
        select RT_USING_WDT
        default n
		
    source "../libraries/HAL_Drivers/Kconfig"    
    
endmenu

menu "Board extended module Drivers"

endmenu
 
endmenu
```
